#include "../qcom/kera-mtp.dtsi"
#include "../qcom/kera_ufs2.dtsi"
#include "../qcom/kera-pm7550ba.dtsi"
#include "../qcom/wlan/kera-wcn7750.dtsi"
#include "../qcom/bt/kera-wcn7750-bt.dtsi"

#include "kera-moorechip-camera-disabled.dtsi"
#include "kera-moorechip-peripherals.dtsi"
#include "kera-moorechip-rpmh.dtsi"
#include "kera-moorechip-thermal.dtsi"
